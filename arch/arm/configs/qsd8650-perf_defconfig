## drivers/misc/a6/Kconfig
```kconfig
menuconfig A6_SUPPORT
	tristate "Palm A6 support"
	depends on I2C
	default y
	help
	  This option enables support for Palm A6 controller.

	  To compile this driver as a module, choose M here.

if A6_SUPPORT

config A6
	tristate "Palm A6 charging controller"
	depends on I2C
	default y
	help
	 Say Y to include support for the Palm A6 charging controller.

config A6_I2C_SINGLE_BYTE
	tristate "Select A6 i2c single byte read"
	depends on I2C && A6
	default n
	help
	 Say Y to enable single byte i2c read for A6 driver.

config A6_I2C_SINGLE_BYTE_WRITE
	tristate "Select A6 i2c single byte write"
	depends on I2C && A6
	default n
	help
	 Say Y to enable single byte i2c write for A6 driver.

config A6_ENABLE_DOCK_PS
	tristate "Select A6 enable dock as separate power supply"
	depends on I2C && A6
	default n
	help
	 Say Y to enable dock showing as separate power supply with A6 driver.

config A6_BATTERY_SCALED_MIN
	int "Scaled battery percentage"
	depends on I2C && A6
	default 0
	help
	 Scale A6 reported battery percent where min percent is reported as 0

endif # POWER_SUPPLY
```

## drivers/usb/otg/Kconfig
```kconfig
#
# USB OTG infrastructure may be needed for peripheral-only, host-only,
# or OTG-capable configurations when OTG transceivers or controllers
# are used.
#

comment "OTG and related infrastructure"

config USB_OTG_UTILS
	bool
	help
	  Select this to make sure the build includes objects from
	  the OTG infrastructure directory.

if USB || USB_GADGET

#
# USB Transceiver Drivers
#
config USB_GPIO_VBUS
	tristate "GPIO based peripheral-only VBUS sensing 'transceiver'"
	depends on GENERIC_GPIO
	select USB_OTG_UTILS
	help
	  Provides simple GPIO VBUS sensing for controllers with an
	  internal transceiver via the otg_transceiver interface, and
	  optionally control of a D+ pullup GPIO as well as a VBUS
	  current limit regulator.

config ISP1301_OMAP
	tristate "Philips ISP1301 with OMAP OTG"
	depends on I2C && ARCH_OMAP_OTG
	select USB_OTG_UTILS
	help
	  If you say yes here you get support for the Philips ISP1301
	  USB-On-The-Go transceiver working with the OMAP OTG controller.
	  The ISP1301 is a full speed USB  transceiver which is used in
	  products including H2, H3, and H4 development boards for Texas
	  Instruments OMAP processors.

	  This driver can also be built as a module.  If so, the module
	  will be called isp1301_omap.

config USB_ULPI
	bool "Generic ULPI Transceiver Driver"
	depends on ARM
	select USB_OTG_UTILS
	help
	  Enable this to support ULPI connected USB OTG transceivers which
	  are likely found on embedded boards.

	  The only chip currently supported is NXP's ISP1504

config TWL4030_USB
	tristate "TWL4030 USB Transceiver Driver"
	depends on TWL4030_CORE && REGULATOR_TWL4030
	select USB_OTG_UTILS
	help
	  Enable this to support the USB OTG transceiver on TWL4030
	  family chips (including the TWL5030 and TPS659x0 devices).
	  This transceiver supports high and full speed devices plus,
	  in host mode, low speed.

config USB_MSM_OTG_72K
	bool "OTG support for Qualcomm on-chip USB controller"
	depends on ARCH_MSM
	select USB_OTG_UTILS
	default USB_MSM_72K
	help
	  Enable this to support the USB OTG transceiver on MSM chips. It
	  handles PHY initialization, clock management, low power mode and
	  workarounds required after resetting the hardware. This driver is
	  required for even peripheral only or host only mode configuration.
	  Supports SRP and HNP when both gadget and Host are selected.

config MSM_OTG_ENABLE_A_WAIT_BCON_TIMEOUT
	bool "Enable A-device timeout for B-device connection"
	depends on USB_MSM_OTG_72K
	default n
	help
	   OTG specification allows A-device to turn off VBUS if B-device
	   fails to signal connect event before TA_WAIT_BCON (1.1 - 30 sec).
	   SRP detection is enabled and hardware is put into low power mode
	   upon this timeout.

	   If you say yes, VBUS will be turned off if B-device does not signal
	   connect in 30 sec. Otherwise VBUS is not turned off when Micro-A
	   cable is connected. But hardware is put into LPM. Say no if leakage
	   currents in your system are minimum.

config USB_MSM_ACA
	bool "Support for Accessory Charger Adapter (ACA)"
	depends on USB_MSM_OTG_72K
	default n
	help
	  Accesory Charger Adapter is a charger specified in USB Battery
	  Charging Specification(1.1). It enables OTG devices to charge
	  while operating as a host or peripheral at the same time.

config NOP_USB_XCEIV
	tristate "NOP USB Transceiver Driver"
	select USB_OTG_UTILS
	help
	 this driver is to be used by all the usb transceiver which are either
	 built-in with usb ip or which are autonomous and doesn't require any
	 phy programming such as ISP1x04 etc.

endif # USB || OTG
```

## drivers/video/msm_pe/vidc/Kconfig
```kconfig
#
# VIDEO CORE
#
menuconfig VIDC
	bool "Video Core Driver"
	depends on ARCH_MSM8X60 || ARCH_MSM7X30
	default y
	---help---
	Say Y here to see options for video device drivers.
	If you say N, all options in this submenu will be skipped and disabled.

config VIDC_720P
	bool "720P Video Core"
	depends on VIDC && ARCH_MSM7X30
	default y
	help
	This option enables support for Video core.

config VIDC_1080P
	bool "1080P Video Core"
	depends on VIDC && ARCH_MSM8X60
	default y
	help
	This option enables support for Video core.

config VIDC_VENC
	tristate "Video encoder"
	depends on VIDC
	default y
	help
	This option enables support for Video encoder.

config VIDC_VDEC
	tristate "Video decoder"
	depends on VIDC
	default y
	help
	This option enables support for Video decoder.
```

## init/Kconfig.palm
```kconfig
menu "Palm general setup"

config PANIC_ON_OOPS
	int "Panic when encountering OOPS"
	default 0
	help
	  If 1, sets behavior on OOPS to panic.

config WARN_ABOUT_MAX_FILES
	bool "Warn when file-max limit is close"
	default n
	help
	  If enabled, a log will start showing warnings

config LINEAR_MIN_FREE_KBYTES
	bool "Use different math for min_free_kbytes"
	default n
	help
	  Grow the reserved memory linearly as a function of the available memory

config PALM_BUILD_GM
	bool "Production release branch"
	default n
	help
	  Usually set automatically within the build environment on production branches.
	  When set, may disable some debug features.

config DEBUG_TZ_COUNTERS
	bool "Instrument power collapse through TZ counters"
	depends on !PALM_BUILD_GM
	default n
	help
	  If enabled, log will show extra debug information from TZ about CPU power collapses

endmenu		# General setup
```

## sound/soc/msm/Kconfig
```kconfig
menu "MSM SoC Audio support"

config SND_MSM_SOC
	tristate "SoC Audio for the MSM series chips"
	depends on ARCH_MSM_ARM11 && SND_SOC && MSM_ADSP
	help
	  To add support for ALSA PCM driver for MSM board.

config SND_MSM7KV2_SOC
	tristate "SoC Audio for the MSM7KV2 chip"
	depends on ARCH_MSM7X30 && SND_SOC && MSM7KV2_AUDIO
	default y
	help
	  To add support for ALSA PCM driver for QSD8k board.

config SND_MSM7KV2_DAI_SOC
	tristate "SoC CPU/CODEC DAI for the MSM7x30 chip"
	depends on SND_MSM7KV2_SOC
	default y
	help
	 To add support for ALSA PCM driver for MSM7x30 board.


config SND_MSM_DAI_SOC
	tristate "SoC CPU/CODEC DAI for the MSM chip"
	depends on SND_MSM_SOC
	default y
	help
	 To add support for ALSA PCM driver for MSM board.

config SND_MSM_SOC_MSM7K
        tristate "SoC Audio support for MSM7K"
        depends on SND_MSM_SOC
	default y
        help
	 To add support for SoC audio on msm7k for msm72x1 or msm7x27

config SND_MSM_SOC_MSM7KV2
	tristate "SoC Audio support for MSM7KV2"
	depends on SND_MSM7KV2_SOC
	default y
	help
	 To add support for SoC audio on qsd8k.

config SND_MVS_SOC
	tristate "SoC Mvs support for MSM7X30"
	depends on MSM7KV2_AUDIO
	default y
	help
	To support Mvs packet capture/playback

config SND_MSM_MVS7x30_SOC
	tristate "SoC MVS7x30 support for MSM7X30"
	depends on SND_MVS_SOC
	default y
	help
	To support Mvs packet capture/playback

config SND_MSM_MVS_DAI_SOC
	tristate "SoC CPU/CODEC DAI for the MSM7x30 chip"
	depends on SND_MVS_SOC || MSM_8x60_VOIP
	default y
	help
	 To add support for ALSA PCM driver for MSM7x30 board.

config SND_SOC_MSM8X60_PCM
	tristate

config SND_SOC_MSM8X60_DAI
	tristate

config SND_SOC_MSM8X60
	tristate "SoC Audio over DSP support for MSM8660"
	depends on ARCH_MSM8X60 && SND_SOC && MSM8X60_AUDIO
	select SND_SOC_MSM8X60_PCM
	select SND_SOC_MSM8X60_DAI
	default y
	help
	 To add support for SoC audio on MSM8X60. This driver
	 Adds support for audio over DSP. The driver adds Kcontrols
	 to do device switch/routing and volume control support for all
	 audio sessions. The kcontols also does sesion management for
	 voice calls


config SND_SOC_MSM8660_PCM
	tristate

config SND_SOC_MSM8660_LPAIF
	tristate

config SND_SOC_MSM8660
	tristate "SoC Machine driver for MSM8660"
	depends on !SND_SOC_MSM8X60
	select SND_SOC_MSM8660_PCM
	select SND_SOC_MSM8660_LPAIF
	select SND_SOC_TIMPANI
	select MARIMBA_CORE
	default n
	help
	 To add support for SoC audio on MSM8660 for direct playback
	 to LPA buffer over DMA.The interface bypasses DSP and hence
	 does not support any post/pre processing features.The driver
	 would support full duplex playback/record sessions.

config SND_VOIP_PCM
	tristate

config MSM_8x60_VOIP
	tristate "SoC Machine driver for voip"
	depends on SND_SOC_MSM8X60
	select SND_MSM_MVS_DAI_SOC
	select SND_VOIP_PCM
	default n
	help
	 To support ALSA VOIP driver for MSM8x60 target.
	 This driver communicates with QDSP6, for getting
	 uplink and downlink voice packets.
endmenu
```
